## build/conf/local.conf
```bitbake
wsl bash -c 'cat > /root/yocto-workspace/build/conf/local.conf << "EOF"
# Yocto Configuration for imx7d-pico with WiFi & Bluetooth

MACHINE ??= 'imx7d-pico'
DISTRO ?= 'fslc-wayland'

# WiFi and Bluetooth support
MACHINE_FEATURES += "wifi bluetooth"
IMAGE_INSTALL += "wireless-tools wpa-supplicant bluez5 weston"

# Image features
EXTRA_IMAGE_FEATURES ?= "debug-tweaks"
USER_CLASSES ?= "buildstats"
PATCHRESOLVE = "noop"

# Disk monitoring
BB_DISKMON_DIRS ??= "\
    STOPTASKS,${TMPDIR},1G,100K \
    STOPTASKS,${DL_DIR},1G,100K \
    STOPTASKS,${SSTATE_DIR},1G,100K \
    STOPTASKS,/tmp,100M,100K \
    HALT,${TMPDIR},100M,1K \
    HALT,${DL_DIR},100M,1K \
    HALT,${SSTATE_DIR},100M,1K \
    HALT,/tmp,10M,1K"

PACKAGECONFIG:append:pn-qemu-system-native = " sdl"
CONF_VERSION = "2"

# Freescale specific
DL_DIR ?= "${BSPDIR}/downloads/"
ACCEPT_FSL_EULA = "1"

# Build configuration
PSEUDO_DISABLED = "1"
export TAR_OPTIONS = "--no-same-owner"
EOF
'
```
